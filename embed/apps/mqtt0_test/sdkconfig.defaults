## embed/apps/mqtt0_test/sdkconfig.defaults
```kconfig
# Enable USB Serial JTAG as console for DevKit boards
CONFIG_ESP_CONSOLE_USB_SERIAL_JTAG=y
```

## embed/esp/led_strip_flash/sdkconfig.defaults
```kconfig
# ESP32-S3-DevKitC-1 with PSRAM
CONFIG_IDF_TARGET="esp32s3"
CONFIG_ESPTOOLPY_FLASHSIZE_2MB=y
CONFIG_SPIRAM=y
CONFIG_SPIRAM_MODE_OCT=y
CONFIG_SPIRAM_SPEED_80M=y

# Compiler optimizations
CONFIG_COMPILER_OPTIMIZATION_SIZE=y

# Logging
CONFIG_LOG_DEFAULT_LEVEL_INFO=y

# LED Strip
CONFIG_BLINK_GPIO=48
CONFIG_BLINK_PERIOD=1000
```
